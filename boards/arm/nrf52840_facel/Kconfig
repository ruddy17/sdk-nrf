## boards/arm/nrf52840_facel/Kconfig
```kconfig
# nRF52840 DK NRF52840 board configuration

# Copyright (c) 2016 Nordic Semiconductor ASA
# SPDX-License-Identifier: Apache-2.0

config BOARD_ENABLE_DCDC
	bool "Enable DCDC mode"
	select SOC_DCDC_NRF52X
	default n
	depends on BOARD_NRF52840_FACEL

config USB_DEVICE_PID
	hex
	default 0x0001
```

## boards/arm/nrf52840_facel/Kconfig.board
```kconfig
# nRF52840 DK NRF52840 board configuration

# Copyright (c) 2016 Nordic Semiconductor ASA
# SPDX-License-Identifier: Apache-2.0

config BOARD_NRF52840_FACEL
	bool "NRF52840_FACEL"
	depends on SOC_NRF52840_QIAA
```

## boards/arm/nrf52840_facel/Kconfig.defconfig
```kconfig
# nRF52840 DK NRF52840 board configuration

# Copyright (c) 2016 Nordic Semiconductor ASA
# SPDX-License-Identifier: Apache-2.0

if BOARD_NRF52840_FACEL

config BOARD
	default "nrf52840_facel"

if USB

config USB_NRFX
	default y

config USB_DEVICE_STACK
	default y

endif # USB

config BT_CTLR
	default BT

endif # BOARD_NRF52840_FACEL
```

## drivers/sensor/mcp3912/Kconfig
```kconfig
# MCP3912 4-Channel Analog Front End

menuconfig MCP3912
	bool "MCP3912 sensor"
	depends on SPI
	help
	  Enable driver for MCP3912 4-Channel Analog Front End.

if MCP3912

choice
	prompt "Trigger mode"
	default MCP3912_TRIGGER_GLOBAL_THREAD
	help
	  Specify the type of triggering used by the driver.

config MCP3912_TRIGGER_GLOBAL_THREAD
	bool "Use global thread"
	depends on GPIO

config MCP3912_TRIGGER_OWN_THREAD
	bool "Use own thread"
	depends on GPIO

endchoice

config MCP3912_THREAD_PRIORITY
	int "Thread priority"
	depends on MCP3912_TRIGGER_OWN_THREAD
	default 10
	help
	  Priority of thread used by the driver to handle interrupts.

config MCP3912_THREAD_STACK_SIZE
	int "Thread stack size"
	depends on MCP3912_TRIGGER_OWN_THREAD
	default 1024
	help
	  Stack size of thread used by the driver to handle interrupts.

endif # MCP3912
```

## dts/bindings/sensor/microchip,mcp3912.yaml
```yaml
description: MCP3912 4-Channel Analog Front End

compatible: "microchip,mcp3912"

include: spi-device.yaml

properties:
    drdy-gpios:
      type: phandle-array
      required: true
      description: |
        The Data Ready pin indicates if a new conversionresult is ready to be read.
        The default state of this pinis logic high when DR_HIZ=1 and is high-impedancewhen DR_HIZ=0
        (default). After each conversion is finished, a logic low pulse will take place 
        on the DataReady pin to indicate the conversion result is ready asan interrupt.
    rst-gpios:
      type: phandle-array
      required: true
      description: |
        This pin places the entire chip in a Reset state when low.
```
